## firmware/boards/shields/my_keyboard/Kconfig.defconfig
```kconfig
if SHIELD_MY_KEYBOARD_LEFT

config ZMK_KEYBOARD_NAME
  default "My Keyboard"

config ZMK_SPLIT_ROLE_CENTRAL
  default y

# number of peripherals (1 for the right half)
config ZMK_SPLIT_BLE_CENTRAL_PERIPHERALS
  default 1

# config BT_MAX_CONN
#   default 6
#
# config BT_MAX_PAIRED
#   default 6
#
config ZMK_STUDIO
  default y

endif

if SHIELD_MY_KEYBOARD_LEFT || SHIELD_MY_KEYBOARD_RIGHT

config ZMK_SPLIT
  default y

config ZMK_DISPLAY
  default y

config SPI
    default y

endif
```

## firmware/boards/shields/my_keyboard/Kconfig.shield
```kconfig
config SHIELD_MY_KEYBOARD_LEFT
  def_bool $(shields_list_contains, my_keyboard_left)

config SHIELD_MY_KEYBOARD_RIGHT
  def_bool $(shields_list_contains, my_keyboard_right)
```

## firmware/config/west.yml
```yaml
manifest:
  defaults:
    revision: v0.3
  remotes:
    - name: zmkfirmware
      url-base: https://github.com/zmkfirmware
    - name: M165437 #nice-view-gem
      url-base: https://github.com/M165437 
    - name: gpeye #hammerbeam-slideshow
      url-base: https://github.com/GPeye
    # - name: englmaxi
    #   url-base: https://github.com/englmaxi
    # - name: mctechnology17
    #   url-base: https://github.com/mctechnology17
  projects:
    - name: zmk
      remote: zmkfirmware
      revision: v0.3
      # revision: main
      path: zmk
      import: app/west.yml
    - name: nice-view-gem
      remote: M165437
      revision: v0.3.0
      # revision: main
      path: deps/nice-view-gem
    - name: hammerbeam-slideshow
      remote: gpeye
      revision: main
      path: deps/hammerbeam-slideshow
    # - name: zmk-dongle-display
    #   remote: englmaxi
    #   revision: main
    #   path: deps/zmk-dongle-display
    # - name: zmk-switch-layout
    #   remote: mctechnology17
    #   revision: main
    #   path: deps/zmk-switch-layout
  self:
    path: config
```
