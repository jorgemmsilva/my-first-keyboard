#include "my_keyboard.dtsi"

&kscan0 {
    col-gpios
        = <&pro_micro 2 GPIO_ACTIVE_HIGH> // col 0
        , <&pro_micro 3 GPIO_ACTIVE_HIGH> // col 1
        , <&pro_micro 4 GPIO_ACTIVE_HIGH> // col 2
        , <&pro_micro 5 GPIO_ACTIVE_HIGH> // col 3
        , <&pro_micro 6 GPIO_ACTIVE_HIGH> // col 4
        , <&pro_micro 7 GPIO_ACTIVE_HIGH> // col 5
        ;
};
