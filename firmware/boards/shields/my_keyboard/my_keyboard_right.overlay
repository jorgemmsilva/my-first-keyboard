#include "my_keyboard.dtsi"

&kscan0 {
    col-gpios
        = <&pro_micro 14 GPIO_ACTIVE_HIGH> // col 5
        , <&pro_micro 15 GPIO_ACTIVE_HIGH> // col 4
        , <&pro_micro 18 GPIO_ACTIVE_HIGH> // col 3
        , <&pro_micro 19 GPIO_ACTIVE_HIGH> // col 2
        , <&pro_micro 20 GPIO_ACTIVE_HIGH> // col 1
        , <&pro_micro 21 GPIO_ACTIVE_HIGH> // col 0
        ;
};

&matrix_transform0 {
    col-offset = <6>;
};

